## sdkconfig.defaults
```kconfig
# Define configuration
# Remove/repace these comments to set level to debug/info

#CONFIG_LOG_DEFAULT_LEVEL_DEBUG=y
#CONFIG_LOG_DEFAULT_LEVEL=4

# Partition Table
CONFIG_PARTITION_TABLE_CUSTOM=y
CONFIG_PARTITION_TABLE_FILENAME="partitions.csv"

# Serial flasher config
CONFIG_ESPTOOLPY_FLASHSIZE_4MB=y
CONFIG_ESPTOOLPY_FLASHSIZE="4MB"

# FreeRTOS
CONFIG_FREERTOS_HZ=100

# For MicroPython
CONFIG_FREERTOS_SUPPORT_STATIC_ALLOCATION=y
CONFIG_FREERTOS_THREAD_LOCAL_STORAGE_POINTERS=2

# SPIRAM
#CONFIG_ESP32_SPIRAM_SUPPORT=y
#CONFIG_SPIRAM_CACHE_WORKAROUND=y
#CONFIG_SPIRAM_IGNORE_NOTFOUND=y
#CONFIG_SPIRAM_USE_MEMMAP=y
```
